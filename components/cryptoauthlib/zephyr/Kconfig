## components/cryptoauthlib/zephyr/Kconfig
```kconfig
# @file      Kconfig
# @brief     cryptoauthlib module Kconfig file
#
# Copyright joelguittet and mender-mcu-client contributors
#
# Licensed under the Apache License, Version 2.0 (the "License");
# you may not use this file except in compliance with the License.
# You may obtain a copy of the License at
#
#     http://www.apache.org/licenses/LICENSE-2.0
#
# Unless required by applicable law or agreed to in writing, software
# distributed under the License is distributed on an "AS IS" BASIS,
# WITHOUT WARRANTIES OR CONDITIONS OF ANY KIND, either express or implied.
# See the License for the specific language governing permissions and
# limitations under the License.

menuconfig CRYPTOAUTHLIB
    bool "Library for interacting with the Crypto Authentication secure elements"
    help
        This library implements the APIs required to communicate with Microchip
        Security device. The family of devices supported currently are: ATSHA204A,
        ATECC108A, ATECC508A, ATECC608A and ATECC608B.

if CRYPTOAUTHLIB

    # HAL selection
    choice CRYPTOAUTHLIB_HAL_TYPE_CHOICE
        prompt "HAL type"
        help
            Select the HAL type to compile

        config CRYPTOAUTHLIB_HAL_I2C
            bool "HAL I2C"
            select I2C

        config CRYPTOAUTHLIB_HAL_SPI
            bool "HAL SPI"
            select SPI

    endchoice # CRYPTOAUTHLIB_HAL_TYPE_CHOICE

    # Library Options
    config CRYPTOAUTHLIB_PRINTF
        bool "Enable Debug print statements in library"
        default n

    config CRYPTOAUTHLIB_JWT_SUPPORT
        bool "Enable jwt functionality"
        default n

    config CRYPTOAUTHLIB_NO_POLL
        bool "Do not use polling to get device responses"
        default n

    config CRYPTOAUTHLIB_NO_HEAP
        bool "Do not use dynamic (heap) allocation functions"
        default n

    config CRYPTOAUTHLIB_USE_ATCAB_FUNCTIONS
        bool "Build the atcab_ api functions rather than using macros"
        default n

    config CRYPTOAUTHLIB_STRICT_C99
        bool "Enable strict C99 compliance for the libray"
        default n

    # Device enablement
    config CRYPTOAUTHLIB_ATSHA204A_SUPPORT
        bool "Include support for ATSHA204A device"
        default y

    config CRYPTOAUTHLIB_ATSHA206A_SUPPORT
        bool "Include support for ATSHA206A device"
        default y

    config CRYPTOAUTHLIB_ATECC108A_SUPPORT
        bool "Include support for ATECC108A device"
        default y

    config CRYPTOAUTHLIB_ATECC508A_SUPPORT
        bool "Include support for ATECC508A device"
        default y

    config CRYPTOAUTHLIB_ATECC608_SUPPORT
        bool "Include support for ATECC608 device"
        default y

    config CRYPTOAUTHLIB_ATECC608A_SUPPORT
        bool "Include support for ATECC608A device"
        select CRYPTOAUTHLIB_ATECC608_SUPPORT
        default n

    config CRYPTOAUTHLIB_ECC204_SUPPORT
        bool "Include support for ECC204 device"
        default y

    config CRYPTOAUTHLIB_TA010_SUPPORT
        bool "Include support for TA010 device"
        default y

    config CRYPTOAUTHLIB_SHA104_SUPPORT
        bool "Include support for SHA104 device"
        default y

    config CRYPTOAUTHLIB_SHA105_SUPPORT
        bool "Include support for SHA105 device"
        default y

endif
```
